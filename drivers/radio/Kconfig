## drivers/radio/Kconfig
```kconfig
menuconfig RADIO
	bool "Radio drivers"
	# All platforms that implement the radio driver are now required to
	# provide relevant DTS entries.
	help
	  Enable radio driver configuration.

if RADIO

module = RADIO
module-str = RADIO

config RADIO_INIT_PRIORITY
	int "Radio driver init priority"
	default KERNEL_INIT_PRIORITY_DEVICE
	help
	  This option controls the priority of the radio device
	  initialization. Higher priority ensures that the device is
	  initialized earlier in the startup cycle. If unsure, leave at default
	  value

source "drivers/radio/Kconfig.efr32"

endif
```

## drivers/radio/Kconfig.efr32
```kconfig
config RADIO_EFR32
	bool "EFR32 radio driver"
    select SOC_GECKO_CUSTOM_RADIO_PHY
	default y
	help
	  Enables EFR32 radio driver.

if RADIO_EFR32

config RADIO_EFR32_TX_BUFFER_SIZE
    int
    default 1024
    help
        Size of the TX FIFO, must be a power of 2 from 64 to 4096

config RADIO_EFR32_RX_BUFFER_SIZE
    int
    default 1024
    help
        Size of the RX FIFO, must be a power of 2 from 64 to 4096

endif
```

## drivers/radio/Kconfig.gecko_rail
```kconfig
config GECKO_RAIL_TX_BUFFER_SIZE
    int
    default 1024
    help
        Size of the TX FIFO, must be a power of 2 from 64 to 4096

config GECKO_RAIL_RX_BUFFER_SIZE
    int
    default 1024
    help
        Size of the RX FIFO, must be a power of 2 from 64 to 4096
```

## dts/bindings/radio/efr32,radio-gecko.yaml
```yaml
description: radio drivers for gecko

compatible: "efr32,radio-gecko"

include: silabs,series2-radio.yaml
```
